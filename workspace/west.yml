## workspace/west.yml
```yaml
manifest:
  defaults:
    remote: upstream

  remotes:
    - name: upstream
      url-base: https://github.com/zephyrproject-rtos

  projects:
    - name: zephyr
      revision: v3.6.0
      import: true

    - name: hal_espressif
      revision: v3.6.0
```
